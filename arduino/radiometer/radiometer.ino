/* 
 * 
 * SCL - A5
 * SDA - A4
 * 
 * 
 * Voltmeter - A3
 * 
 * PWM - D9
 * Input - D2, D5
 * 
 * buzzer - D7
 * 
 */


#include <Bounce2.h>

#include <SPI.h>
#include <Wire.h>
#include <Adafruit_GFX.h>
#include <Adafruit_SSD1306.h>

#define OLED_RESET 4
Adafruit_SSD1306 display(OLED_RESET);

#define NUMFLAKES 10
#define XPOS 0
#define YPOS 1
#define DELTAY 2

//////////////////////////////////////////////////////////////////////////////

unsigned long previousMillis = 0; 
unsigned long previousMillis1 = 0; 
const long interval = 40000/2;   // /2 - деление на два при двух счетчиках Гейгера //36000 мc для стс-5, 40000 мс для сбм-20
const long interval1 = 500; 

//значок радиации
static const unsigned char PROGMEM lcd_bmp[] =
{ 0x0, 0x0, 0x0, 0x0, 0x0, 0x0, 0x0, 0x0, 0x0, 0x0, 0x0, 0x0, 0x0, 0x0, 0x0, 0x0, 
0x0, 0x0, 0x0, 0x0, 0x0, 0x0, 0x0, 0x0, 0x0, 0x0, 0x0, 0x0, 0x0, 0x0, 0x0, 0x0, 
0x0, 0x0, 0x0, 0x0, 0x0, 0x0, 0x0, 0x0, 0x0, 0x0, 0x0, 0x0, 0x0, 0x0, 0x0, 0x0, 
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0x0, 0x0, 0x0, 0x0, 0x0, 0x0, 0x0, 0x0, 0x0, 0x0, 0x0, 0x0, 0x0, 0x0, 0x0, 0x0
};

static const unsigned char PROGMEM logo[] =
{
0x00, 0x00, 0x00, 0x00, 0x00, 0x00, 0x00, 0x00, 0x00, 0x00, 0x00, 0x00, 0x00, 0x00, 0x00, 0x00,
0x00, 0x00, 0x00, 0x00, 0x00, 0x00, 0x00, 0x00, 0x00, 0x00, 0x00, 0x00, 0x00, 0x7F, 0xE0, 0x00,
0x00, 0x00, 0x00, 0x00, 0x00, 0x00, 0x00, 0x00, 0x00, 0x00, 0x00, 0x00, 0x01, 0x80, 0x1C, 0x00,
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0x00, 0x00, 0x00, 0x00, 0x00, 0x00, 0x00, 0x00, 0x00, 0x00, 0x00, 0x00, 0x00, 0x00, 0x00, 0x00
};

static const unsigned char PROGMEM fl[] =
{ 0x00, 0x00, 0x00, 0x00, 0x00, 0x00, 0x00, 0x00, 0x00, 0x00, 0x00, 0x00, 0x00, 0x00, 0x00, 0x00,
0x00, 0x00, 0x00, 0x00, 0x00, 0x00, 0x00, 0x00, 0x00, 0x00, 0x00, 0x00, 0x00, 0x00, 0x00, 0x1E,
0x00, 0x00, 0x00, 0x00, 0x00, 0x00, 0x00, 0x00, 0x00, 0x00, 0x00, 0x00, 0x00, 0x00, 0x00, 0x1E,
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0x00, 0x00, 0x00, 0x00, 0x00, 0x00, 0x00, 0x00, 0x00, 0x00, 0x00, 0x00, 0x00, 0x00, 0x00, 0x00 };

static const unsigned char PROGMEM bt1[] =
{ 0x00, 0x00, 0x00, 0x00, 0x00, 0x00, 0x00, 0x00, 0x00, 0x00, 0x00, 0x00, 0x00, 0x00, 0x00, 0x00,
0x00, 0x00, 0x00, 0x00, 0x00, 0x00, 0x00, 0x00, 0x00, 0x00, 0x00, 0x00, 0x00, 0x00, 0x00, 0x00,
0x00, 0x00, 0x00, 0x00, 0x00, 0x00, 0x00, 0x00, 0x00, 0x00, 0x00, 0x00, 0x00, 0x00, 0x00, 0x00,
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0x00, 0x00, 0x00, 0x00, 0x00, 0x00, 0x00, 0x00, 0x00, 0x00, 0x00, 0x00, 0x00, 0x00, 0x00, 0x00 };

//#if (SSD1306_LCDHEIGHT != 32)
//#error("Height incorrect, please fix Adafruit_SSD1306.h!");
//#endif

const int buttonPin = 2; 
const int ledPin =  13;
const int mode0_times = 4;

int buttonState = 0;
int bt = 0;
int pbt = 0;
int s1 = 0;
int mode = 0;
boolean sound = false;

String out = "";

int n1_counter = 0;
int avg[mode0_times];
//int arr_mes[10];

//int bat_t = 0; //для батареи, чтобы пропускать лишние циклы оповещений по serial

unsigned long j;
unsigned long CR = 0;
unsigned long CR_average = 0;

unsigned long cs;
int sec;
int val; //

/////////////////////////////////

float input_voltage = 0.0;
float temp=0.0;


///////////////////////////////////

Bounce bouncer = Bounce();
Bounce bouncer2 = Bounce();


void setup() {

	Serial.begin(9600);
	display.begin(SSD1306_SWITCHCAPVCC, 0x3C);  // initialize with the I2C addr 0x3C (for the 128x32)

	display.display();

	display.clearDisplay();

	display.drawBitmap(0, 0, logo, 128, 64, WHITE);
	display.display();
	delay(2000);
	display.clearDisplay();
	
	TCCR1A = TCCR1A & 0xe0 | 2;
	TCCR1B = TCCR1B & 0xe0 | 0x09; 
	analogWrite(9,22); // на выводе 9 ШИМ=10%

	pinMode(ledPin, OUTPUT); //

	pinMode(7, OUTPUT); // buzzer

	pinMode(2, INPUT); // cчётчик на пине 2
	digitalWrite(2, HIGH); // подключаем встроенный подтягивающий резистор
	bouncer.attach(2); // устанавливаем кнопку
	bouncer.interval(5); // устанавливаем параметр stable interval = 5 мс
	
	pinMode(5, INPUT);
	digitalWrite(5, HIGH);
	bouncer2.attach(5);
	bouncer2.interval(5);
	
	pinMode(3, INPUT);
	digitalWrite(3, HIGH);  //для кнопки динамика
}

void loop() {
	unsigned long currentMillis = millis();
	unsigned long currentMillis1 = millis();
////////////////////////////////////////////VOLTMETER PIN A3////////////////////////////////////////////////////////////////////

	int analog_value = analogRead(A3);
	input_voltage = (analog_value * 5.0) / 1024.0;
		 
	if (input_voltage < 0.12) {
		input_voltage=0.0;
	}
	
	//String str = "v" + String(input_voltage);
	//bat_t += 1;
	//if (bat_t/128 == 1) {
		////Serial.println(str);
		//bat_t = 0;
	//}

///////////////////////////////////////////////////////////////////////////////////////////////////////////////////////////////

	if (bouncer.update()) { //если произошло событие
		if (bouncer.read()==0) {
			bt++;
		}
	}
	if (bouncer2.update()) { //если произошло событие
		if (bouncer2.read()==0) {
			bt++;
		}
	}
	
//	if (digitalRead(2) == LOW) {  //раскомментировать для отключения защиты от дребезга, bouncer'ы выше удалить
//		bt++;
//	}
//	if (digitalRead(5) == LOW) {
//		bt++;
//	}

	if (Serial.available()) {
		val = Serial.read();
		if (val == '0') {
		  mode = 0;
		}
		
		if (val == 5) {
			sound = false;
		}
		if (val == 6) {
			sound = true;
		}
		
	}

	//режим от howtodo
	//if (mode == 1) {
		//if (currentMillis - previousMillis >= interval) {
			//previousMillis = currentMillis;
			//CR = bt;
			//bt = 0;
		//}
	//}

	//режим поиска
	if (mode == 0) {
		if (currentMillis - previousMillis >= interval/mode0_times) {
			previousMillis = currentMillis;
			avg[n1_counter] = bt*mode0_times;
			n1_counter += 1;
			CR = bt*mode0_times;
			out += String(CR);
			out += "|";
			//String str = "c" + String(CR);
			//Serial.println(str);
			int i = 0;
			int sum = 0;
			int avg_ = 0;
			for (i = 0; i < mode0_times; i++){
				sum+=avg[i];
				avg_ = sum/mode0_times;
				}
			CR_average = avg_;
			if (n1_counter == mode0_times) {
				n1_counter = 0;
			}
			out += String(avg_);
			out += "|";
			
			out += String(input_voltage);
			
			Serial.println(out);
			out = "";
			
			bt = 0;
		}
	}
	

////////////////////////////////////////////////////////////////////////////////////////////////////////////////////////////////
	if (bt != pbt) {
		pbt = bt;
		s1 = 1;
}

	
///////////////////////////////////////////////TEXT ON DISPLAY//////////////////////////////////////////////////////////////////
//display.clearDisplay();
	//display.setTextSize(2);
	//display.setTextColor(WHITE);
	//display.setCursor(10,0);
	//display.clearDisplay();
	//display.println(CR);
	//display.setCursor(10,18);
	//display.println(bt);
	//display.setCursor(40,18);
	//display.println();
	//display.setTextSize(1);
	//display.setCursor(40,0);
	//display.println("mkR/hr");
	display.clearDisplay();
	display.setTextSize(2);
	display.setTextColor(WHITE);
	display.setCursor(10, 9);
	display.clearDisplay();
	display.println(CR);
	display.setTextSize(1);
	display.setCursor(10, 0);
	display.println("uR/h");
	display.setCursor(50, 0);
	if (mode == 0) {
		display.println("SEARCH");
		if (avg[mode0_times-1] != 0) {
			display.setCursor(10, 24);
			display.println(CR_average);
		}
	}
	display.setCursor(100, 0);
	
/////////////////////////////////////////////////BATTERY  INDICATION////////////////////////////////////////////
display.drawBitmap(0, 0, fl, 128, 64, WHITE);

if (input_voltage > 3.3) {
	display.drawBitmap(0, 0, bt1, 128, 64, WHITE);
	if (input_voltage > 3.4) {
		display.drawBitmap(0, -5, bt1, 128, 64, WHITE);
		if (input_voltage > 3.5) {
			display.drawBitmap(0, -10, bt1, 128, 64, WHITE);
			 if (input_voltage > 3.6) {
				display.drawBitmap(0, -15, bt1, 128, 64, WHITE);
				if (input_voltage > 3.8) {
					display.drawBitmap(0, -20, bt1, 128, 64, WHITE);
				}
			}
		}
	}
}
////////////////////////////////////////////////////RADIATION ICON AND BUZZER/////////////////////////////////////////////////////////////
if (s1 == 1){
		display.drawBitmap(13, 1, lcd_bmp, 128, 64, WHITE);
		if (sound) {
			digitalWrite (7, HIGH); // buzzer ON
		}
}
else
{
		digitalWrite (7, LOW); // buzzer OFF
}
/////////////////////////////////////////////////////////////////////////////////////////////////////////////////
 if (currentMillis1 - previousMillis1 >= interval1) {
		previousMillis1 = currentMillis1;    
		if (s1 == 1){
			s1=0;
		}
	}
	display.display();
}
/////////////////////////////////////////////////////////////////////////////////////////////////////////////////
